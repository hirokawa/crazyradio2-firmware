## boards/seeed/seeed_xiao_ble/board.yml
```yaml
board:
  name: seeed_xiao_ble
  full_name: XIAO BLE
  vendor: seeed
  socs:
  - name: nrf52840
```

## boards/seeed/seeed_xiao_ble/seeed_xiao_ble_defconfig
```kconfig
# SPDX-License-Identifier: Apache-2.0

# Enable MPU
CONFIG_ARM_MPU=y

# Enable hardware stack protection
CONFIG_HW_STACK_PROTECTION=y

# Enable GPIO
CONFIG_GPIO=y

# Enable UART driver
CONFIG_SERIAL=y

# Enable console
CONFIG_CONSOLE=y

# Disable FEM
#CONFIG_FEM=y

# Regulation for Japan
CONFIG_JP_REG=y

# Build UF2 by default, supported by the Adafruit nRF52 Bootloader
CONFIG_BUILD_OUTPUT_UF2=y
CONFIG_USE_DT_CODE_PARTITION=y

#CONFIG_TARGET_UF2_BOOTLOADER=n

#CONFIG_LOG=y
#CONFIG_LOG_RUNTIME_FILTERING=y
#CONFIG_LOG_BUFFER_SIZE=2048
#CONFIG_LOG_PRINTK=y
#CONFIG_LOG_PROCESS_TRIGGER_THRESHOLD=0
```
